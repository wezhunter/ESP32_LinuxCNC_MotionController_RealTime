## sdkconfig.defaults
```kconfig
CONFIG_AUTOSTART_ARDUINO=1
# CONFIG_WS2812_LED_ENABLE is not set
CONFIG_FREERTOS_HZ=1000
CONFIG_MBEDTLS_PSK_MODES=1
CONFIG_MBEDTLS_KEY_EXCHANGE_PSK=1
ARDUINO_USB_MODE=1
ARDUINO_USB_CDC_ON_BOOT=1
CONFIG_ARDUINO_USB_MODE=0
CONFIG_ARDUINO_USB_CDC_ON_BOOT=1
```
